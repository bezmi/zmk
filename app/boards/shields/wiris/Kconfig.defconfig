## app/boards/shields/wiris/Kconfig.defconfig
```kconfig
if SHIELD_WIRIS_DONGLE

config ZMK_KEYBOARD_NAME
	default "Wiris"

config ZMK_SPLIT_ROLE_CENTRAL
	default y

endif

if SHIELD_WIRIS_LEFT || SHIELD_WIRIS_RIGHT || SHIELD_WIRIS_DONGLE
# config ZMK_SLEEP
# 	default y

config BT_SETTINGS
	default y

config ZMK_SPLIT
	default y

endif
```
